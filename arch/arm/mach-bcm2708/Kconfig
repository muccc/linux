## arch/arm/mach-bcm2708/Kconfig
```kconfig
menu "Broadcom BCM2708 Implementations"
	depends on ARCH_BCM2708

config MACH_BCM2708
	bool "Broadcom BCM2708 Development Platform"
	select NEED_MACH_MEMORY_H
	select NEED_MACH_IO_H
	select CPU_V6
	help
	  Include support for the Broadcom(R) BCM2708 platform.

config BCM2708_GPIO
	bool "BCM2708 gpio support"
	depends on MACH_BCM2708
	select ARCH_REQUIRE_GPIOLIB
        default y
	help
	  Include support for the Broadcom(R) BCM2708 gpio.

config BCM2708_VCMEM
	bool "Videocore Memory"
	depends on MACH_BCM2708
        default y
        help
          Helper for videocore memory access and total size allocation.

config BCM2708_NOL2CACHE
	bool "Videocore L2 cache disable"
	depends on MACH_BCM2708
        default n
        help
          Do not allow ARM to use GPU's L2 cache. Requires disable_l2cache in config.txt.

config BCM2708_DMAER
	tristate "BCM2708 DMA helper"
	depends on MACH_BCM2708
        default n
        help
          Enable DMA helper for accelerating X composition

config BCM2708_SPI
	bool "Bind a driver to SPI0 master"
	depends on MACH_BCM2708
	depends on SPI
	default y
	help
		Let's you select which driver to bind to SPI0 master

choice
	prompt "Bind driver to SPI0 master"
	depends on BCM2708_SPI
	default BCM2708_SPI_NONE
	default BCM2708_SPI_SPIDEV if SPI_SPIDEV
	default BCM2708_SPI_MAX7301 if GPIO_MAX7301

config BCM2708_SPI_NONE
	bool "None"

config BCM2708_SPI_MAX7301
	bool "Bind MAX7301 to SPI0 master"
	depends on GPIO_MAX7301
	help
		Binds gpio-max7301 driver to the SPI0 master

config BCM2708_SPIDEV
	bool "Bind spidev to SPI0 master"
	depends on SPI_SPIDEV
	help
		Binds spidev driver to the SPI0 master
endchoice

endmenu
```
